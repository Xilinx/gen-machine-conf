## gen-machine-scripts/configs/Kconfig.bootcompconfigurations
```kconfig
# Copyright (C) 2023-2026, Advanced Micro Devices, Inc.  All rights reserved.
#
# SPDX-License-Identifier: MIT
#

if SUBSYSTEM_ARCH_AARCH64
menu "Trusted Firmware ARM (TF-A) Configuration"
config SUBSYSTEM_TF-A_MEMORY_SETTINGS
	bool "TF-A memory settings"
	default n
	help
	 Select this option, if membase and memsize settings of TF-A are to be modified.These are defined already in tfa source.
	  Use this option inorder to over-ride these values.For further info: ref trusted-firmware-arm/docs/plat/*.md's

if SUBSYSTEM_TF-A_MEMORY_SETTINGS
config SUBSYSTEM_TF-A_MEM_BASE
	hex "TF-A MEM BASE"
	default 0xFFFEA000
	help
	  On default the TF-A is placed in OCM memory. Alternatively, the TF-A can be
	  placed in DRAM by updating TF-A_MEM_BASE and TF-A_MEM_SIZE.

config SUBSYSTEM_TF-A_MEM_SIZE
	hex "TF-A MEM SIZE"
	default 0x16000
	help
	  Mention the TF-A size.
endif

config SUBSYSTEM_TF-A_EXTRA_COMPILER_FLAGS
	string "TF-A extra compiler flags"
	default ""
	help
	  TF-A extra compilation flags. You can specify multiple flags separated with semicolon.
	  (NEW!) : ZYNQMP_WDT_RESTART=1 for Special handling to cleanly restart the APU during AWDT recovery
	  Other E.g. MAKEARCH+=RESET_TO_BL31=1 SPD=tspd; ATF_BUILD_TARGET=bl31 bl32

config SUBSYSTEM_TF-A_DEBUG
	bool "TF-A debug"
	default n
	help
	 Select this option for selecting TF-A debug mode

endmenu
endif

if SYSTEM_VERSAL-2VE-2VM
menu "optee configuration"
config SUBSYSTEM_OPTEE
	bool "OP-TEE config"
	default ""
	help
         Select this option for enable/disable OP-TEE

config SUBSYSTEM_OPTEE_MEMORY_SETTINGS
        bool "OP-TEE memory settings"
        default n
        depends on SUBSYSTEM_OPTEE
        help
          Select this option if the TZDRAM base and size for OP-TEE must be
          modified. These values will override defaults and be passed to OP-TEE
          via Yocto OE_EXTRA variables.

if SUBSYSTEM_OPTEE_MEMORY_SETTINGS
config SUBSYSTEM_OPTEE_TZDRAM_START
        hex "OP-TEE TZDRAM START"
        default 0x1800000
        help
          Base address for OP-TEE secure memory (TZDRAM)

config SUBSYSTEM_OPTEE_TZDRAM_SIZE
        hex "OP-TEE TZDRAM SIZE"
        default 0x8000000
        help
          Size of the OP-TEE secure memory (TZDRAM)
endif

endmenu
endif

# u-boot and Linux are not used for 32-bit MicroBlaze-V (Zephyr).
if !SUBSYSTEM_MICROBLAZE_V_XLEN_32
menu "u-boot Configuration"
config SUBSYSTEM_UBOOT_CONFIG_TARGET
	string "u-boot config target"
	help
	  Keep empty or specify auto/AUTO it will point to the default
	  defconfig file based on the yocto machine name.
	  Specify a u-boot config target when building u-boot, it will run
	  run u-boot XXX config target: make XXX_config to configure u-boot
	  first.

config SUBSYSTEM_UBOOT_SPL_BINARY_TYPE
	string "SPL binary type"
	default "spl/u-boot-spl.bin"
	depends on SUBSYSTEM_SDT_FLOW && SUBSYSTEM_MICROBLAZE_V_XLEN_64
	help
	  The file type for the Secondary Program Loader (SPL).

menu "u-boot script configuration"
config SUBSYSTEM_UBOOT_APPEND_BASEADDR
	bool "Append base address to image offsets"
	default y
	help
	  Enable this to apped Memory/DDR base address to the offsets specified.

if !SUBSYSTEM_ARCH_MICROBLAZE-V
config SUBSYSTEM_UBOOT_QSPI_BOOTSCR_OFFSET
	string "QSPI/OSPI Boot script offset"
	default "AUTO"
	help
	  Specify the QSPI/OSPI boot script offset to read the boot script from Flash.
	  if QSPI/OSPI boot script offset value modified then QSPI/OSPI boot script size
	  value should also change.

config SUBSYSTEM_UBOOT_QSPI_BOOTSCR_SIZE
	string "QSPI/OSPI Boot script size"
	default "AUTO"
	help
	  Specify the QSPI/OSPI boot script size to read the boot script from Flash.
	  if QSPI/OSPI boot script size value modified then QSPI/OSPI boot script offset
	  value should also change.
endif
endmenu
endmenu

menu "Linux Configuration"
config SUBSYSTEM_LINUX_CONFIG_TARGET
	string "linux config target"
	help
	  Keep empty or specify auto/AUTO it will point to the default
	  defconfig file based on the yocto machine name.
	  Specify a linux config target when building linux, it will run
	  run linux XXX config target: make XXX_config to configure linux
	  first.

endmenu
endif
```

## gen-machine-scripts/configs/Kconfig.dtgsettings
```kconfig
# Copyright (C) 2023-2026, Advanced Micro Devices, Inc.  All rights reserved.
#
# SPDX-License-Identifier: MIT
#

menu "DT Settings"
config SUBSYSTEM_DT_WORKSPACE
	string "Device-tree workspace"
	help
	  Provide the location to use as Device-tree workspace location.

config SUBSYSTEM_DT_DOMAIN_ACCESS
	bool "Enable Domain Access"
	default n
	depends on SUBSYSTEM_SDT_FLOW
	help
	  Enable this option to use the domain_access assist to generate domain-specific
	  DTS files from the specified YAML files specified in the
	  YOCTO_MC_DOMAIN_FILEPATH configuration

config SUBSYSTEM_DT_INCLUDE_INFRASTRUCTURE
	string "Infrastructure categories for domain device inventory"
	default "all"
	depends on SUBSYSTEM_DT_DOMAIN_ACCESS
	help
	  Infrastructure categories passed to lopper sdt_devices through
	  --include-infrastructure. Use all (the default) or a comma-separated
	  list, such as protection,interconnect,slcr. An empty value uses all.
	  Use sdt_devices --list-infrastructure to list supported categories.
	  Domain wildcards select from this inventory. This option does not
	  bypass device discovery requirements or include clocks separately.

endmenu

if !SUBSYSTEM_ARCH_MICROBLAZE-V
menu "FPGA Manager"
config SUBSYSTEM_FPGA_MANAGER
        bool "Fpga Manager"
        help
	 Select this option to provides an interface to the Linux for configuring the programmable logic(PL).

if SUBSYSTEM_FPGA_MANAGER && SUBSYSTEM_SDT_FLOW
choice
	prompt "PL Device-Tree Overlay Type"

config SUBSYSTEM_PL_DT_OVERLAY_FULL
	bool "full"

config SUBSYSTEM_PL_DT_OVERLAY_DFX
	bool "dfx"

endchoice

config SUBSYSTEM_PL_INPUT_DTSI
	string "PL overlay input dtsi"
	default ""
	help
	  Provide input device tree source (.dtsi) file(s) to merge with the default
	  pl.dtso generated by the xlnx_overlay_pl_dt lopper assist.
	  The provided dtsi changes will be merged into the generated PL overlay.
	  Multiple files can be specified separated by spaces.
	  Leave empty to use only the default pl.dtso.

endif
endmenu
endif
```

## gen-machine-scripts/configs/Kconfig.main
```kconfig
# Copyright (C) 2021-2022, Xilinx, Inc.  All rights reserved.
# Copyright (C) 2022-2026, Advanced Micro Devices, Inc.  All rights reserved.
#
# SPDX-License-Identifier: MIT
#

choice
	prompt "Subsystem Architecture (NO EDIT!)"
	default SUBSYSTEM_ARCH_AARCH64 if SYSTEM_ZYNQMP || SYSTEM_VERSAL || SYSTEM_VERSAL-2VE-2VM || SYSTEM_VERSAL-2VP
	default SUBSYSTEM_ARCH_MICROBLAZE-V if SYSTEM_MICROBLAZE-V
	default SUBSYSTEM_ARCH_ARM
	help
	  This option is to control the processor targeted by System Configuration.
	  WARNING: Do not edit this option.

config SUBSYSTEM_ARCH_AARCH64
	bool "aarch64"
	help
	  Choose this option to specify AARCH64 as the SUBSYSTEM architecture

config SUBSYSTEM_ARCH_ARM
	bool "arm"
	help
	  Choose this option to specify ARM as the SUBSYSTEM architecture

config SUBSYSTEM_ARCH_MICROBLAZE-V
	bool "microblaze-v"
	help
	  Choose this option to specify MicroBlaze-V as the SUBSYSTEM architecture
endchoice

config SUBSYSTEM_ENDIAN_LITTLE
	bool
	default y

if SUBSYSTEM_SDT_FLOW

source ./Kconfig.bootcompselection

endif

source ./Kconfig.syshw

source ./Kconfig.dtgsettings

source ./Kconfig.bootcompconfigurations

source ./Kconfig.yoctomachinesettings
```

## gen-machine-scripts/configs/Kconfig.yoctomachinesettings
```kconfig
# Copyright (C) 2023-2026, Advanced Micro Devices, Inc.  All rights reserved.
#
# SPDX-License-Identifier: MIT
#
#
config YOCTO_MACHINE_NAME
       string "Yocto Machine Name"
       default "versal-net-generic" if SUBSYSTEM_VARIANT_VERSALNET
       default "versal-generic" if SYSTEM_VERSAL
       default "versal-2ve-2vm-generic" if SYSTEM_VERSAL-2VE-2VM
       default "versal-2vp-generic" if SYSTEM_VERSAL-2VP
       default "zynqmp-generic" if SYSTEM_ZYNQMP
       default "zynq-generic" if SUBSYSTEM_ARCH_ARM
       default "microblaze-v-generic" if SUBSYSTEM_ARCH_MICROBLAZE-V
       help
         You can specify MACHINE_NAME using this variable.
	 Auto append the deviceId to Machine Name if this matches with INCLUDE_MACHINE_NAME

config YOCTO_INCLUDE_MACHINE_NAME
	string "Yocto Include Machine name"
	help
	  Specify MACHINE_NAME which will need to be include into the YOCTO_MACHINE file

config YOCTO_ADD_OVERRIDES
	string "Yocto Additional Overrides"
	default ""
	help
	  Specify additional overrides to the generated machine conf file
	  Specify multiple overrides with ':' separator

if SUBSYSTEM_SDT_FLOW

if !SUBSYSTEM_ARCH_MICROBLAZE-V
config YOCTO_MACHINE_FEATURE_EFI
        bool "Enable EFI Machine Feature"
        default y if SUBSYSTEM_ARCH_AARCH64
        help
          Enable this option to use the EFI Boot Manager, which manages and selects bootable
          operating systems and EFI applications stored in firmware. It determines the boot order,
          supports multiple operating systems, and loads the selected bootloader from the EFI
          System Partition, providing flexible and reliable UEFI-based system startup.
endif

if SUBSYSTEM_VARIANT_ZYNQMPEV
menuconfig YOCTO_MACHINE_HWCODECS
        bool "Hardware codecs (MACHINE_HWCODECS)"
        default y
        help
          Enable and select the hardware codec engines assigned to
          MACHINE_HWCODECS in the generated machine conf.

if YOCTO_MACHINE_HWCODECS
config YOCTO_MACHINE_HWCODECS_ENGINE_LIBVCU-OMXIL
        bool "libvcu-omxil"
        depends on SUBSYSTEM_VARIANT_ZYNQMPEV
        default y
        help
          Use the libvcu-omxil OpenMAX IL hardware codec engine.

config YOCTO_MACHINE_HWCODECS_EXTRA
        string "Additional (user-defined) hardware codecs"
        default ""
        help
          Specify additional hardware codec entries to append to
          MACHINE_HWCODECS. Separate multiple values with spaces.
endif
endif

@@multiconfigmenustr@@

config YOCTO_MC_DOMAIN_FILEPATH
	string "Domain file Path"
	default ""
	help
	  Specify the domain file path to use in the generation of multiconfig files.

endif
```
